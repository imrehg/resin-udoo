## layers/meta-resin-udoo/conf/machine/udoo-quad.conf
```bitbake
#@TYPE: Machine
#@NAME: BeagleBone Green
#@DESCRIPTION: Machine configuration for the BeagleBone Green

MACHINEOVERRIDES = "udoo:${MACHINE}"

include conf/machine/udooqdl.conf
```
